## main/Kconfig.projbuild
```kconfig
menu "AquaPilot Configuration"

    config ESP_WIFI_SSID
        string "Default WiFi SSID"
        default ""
        help
            Optional default SSID (2.4 GHz). Saved credentials in NVS take precedence.
            You can also enter credentials on the Settings screen.

    config ESP_WIFI_PASSWORD
        string "Default WiFi Password"
        default ""
        help
            Optional default Wi-Fi password. Leave empty for open networks.

    config AQUAPILOT_HEATER_BLE_NAME_PREFIX
        string "Chihiros heater BLE name prefix"
        default "DYH1"
        help
            Advertised BLE name prefix for the Chihiros aquarium heater.
            Scan connects to the first device whose name starts with this prefix.

    config AQUAPILOT_LIGHT_BLE_NAME_PREFIX
        string "Fluval Plant 4.0 BLE name prefix"
        default "Plant4.0"
        help
            Advertised BLE name prefix for the Fluval Plant 4.0 aquarium light.
            Scan connects to the first device whose name starts with this prefix.

    config AQUAPILOT_WSAMPLE_SAVE_TRACE
        bool "Trace water sample Save button / flicker debug"
        default y
        help
            Log wsample_ui timeline, focus events, and invalidate-area counts to serial
            when Save Sample is pressed. Disable after debugging.

    config AQUAPILOT_WSAMPLE_SAVE_SKIP_SD
        bool "Water sample save: skip SD worker (UI-only debug)"
        default n
        depends on AQUAPILOT_WSAMPLE_SAVE_TRACE
        help
            On Save, run only the UI batch (no SD I/O). Use to see if flicker is SD-related.

endmenu
```
